/*
 * Copyright (c) 2017, The Linux Foundation. All rights reserved.
 *
 * This program is free software; you can redistribute it and/or modify
 * it under the terms of the GNU General Public License version 2 and
 * only version 2 as published by the Free Software Foundation.
 *
 * This program is distributed in the hope that it will be useful,
 * but WITHOUT ANY WARRANTY; without even the implied warranty of
 * MERCHANTABILITY or FITNESS FOR A PARTICULAR PURPOSE.  See the
 * GNU General Public License for more details.
 */

/dts-v1/;

#include "sdm450.dtsi"
#include "msm8953-qrd-sku3.dtsi"

/ {
	model = "Qualcomm Technologies, Inc. SDM450 + PMI8940 QRD";
	compatible = "qcom,sdm450-qrd", "qcom,sdm450", "qcom,qrd";
	qcom,board-id = <0x1000b 1>;
	qcom,pmic-id = <0x010016 0x020040 0x0 0x0>;
	qcom,pmic-name = "PMI8940";
};

&{/reserved-memory} {
	ramoops_mem: ramoops@91400000 {
		compatible = "ramoops";
		reg = <0x0 0x91400000 0x0 0x400000>;
		record-size = <0x80000>;
		console-size = <0x100000>;
		pmsg-size = <0x200000>;
	};
};
